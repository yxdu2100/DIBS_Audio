## CMakeLists.txt
```
cmake_minimum_required(VERSION 3.20.0)
# Board definition lives in <repo>/boards/dibs.
list(APPEND BOARD_ROOT ${CMAKE_CURRENT_SOURCE_DIR}/../..)
find_package(Zephyr REQUIRED HINTS $ENV{ZEPHYR_BASE})

project(dibs_sleep_floor)

target_sources(app PRIVATE src/main.c)
```

## prj.conf
```kconfig
# Nothing but the board init: no BLE, logging, console, I2C or GPIO driver
# activity. Measures the board's hardware sleep current.
CONFIG_LOG=n
CONFIG_CONSOLE=n
CONFIG_RTT_CONSOLE=n
CONFIG_USE_SEGGER_RTT=n
CONFIG_SERIAL=n
CONFIG_I2C=n
CONFIG_GPIO=n
```

## src/main.c
```c
/*
 * Sleep-floor test: after reset every chip on the board is in its power-on
 * state (IMU powered down, microphone without clock, fuel gauge and charger
 * idle) and the nRF52832 sleeps in System ON with only the RTC running.
 * Power-cycle the board before measuring: a WDT left running by the main
 * firmware would otherwise reset this one.
 */
#include <zephyr/kernel.h>

int main(void)
{
	return 0;
}
```
