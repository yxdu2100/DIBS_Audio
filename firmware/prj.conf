## CMakeLists.txt
```
cmake_minimum_required(VERSION 3.20.0)
# Board definition lives in <repo>/boards/dibs.
list(APPEND BOARD_ROOT ${CMAKE_CURRENT_SOURCE_DIR}/..)
find_package(Zephyr REQUIRED HINTS $ENV{ZEPHYR_BASE})

project(dibs_firmware)

target_sources(app PRIVATE
    src/main.c
    src/adpcm.c
    src/audio.c
    src/ble.c
    src/battery.c
    src/imu.c
    src/power.c
    src/session.c
    src/timebase.c
    src/watchdog.c
)
```

## prj.conf
```kconfig
CONFIG_LOG=y

# Recovery: task watchdog over the hardware WDT, reboot on fatal errors
CONFIG_WATCHDOG=y
CONFIG_TASK_WDT=y
CONFIG_TASK_WDT_HW_FALLBACK=y
# Hardware WDT reload ~1 s instead of 120 ms: fewer wake-ups to feed it.
CONFIG_TASK_WDT_MIN_TIMEOUT=1000
CONFIG_RESET_ON_FATAL_ERROR=y

# Battery: MAX17048 fuel gauge, BQ25180 charger
CONFIG_FUEL_GAUGE=y
CONFIG_CHARGER=y

# Session clock: TIMER3 + PPI capture of the PDM start
CONFIG_NRFX_PPI=y

# Microphone
CONFIG_AUDIO=y
CONFIG_AUDIO_DMIC=y

# Bluetooth peripheral
CONFIG_BT=y
CONFIG_BT_PERIPHERAL=y
# Replaced at boot by "DIBS_Audio-XXXX" from the FICR device ID (ble.c)
CONFIG_BT_DEVICE_NAME="DIBS_Audio-0000"
CONFIG_BT_DEVICE_NAME_DYNAMIC=y
CONFIG_BT_DEVICE_NAME_MAX=16
CONFIG_BT_MAX_CONN=1

# Throughput: 2M PHY, 251-byte data length, 247-byte ATT MTU (negotiated
# automatically; USER_PHY_UPDATE only enables the le_phy_updated log callback)
CONFIG_BT_USER_PHY_UPDATE=y
CONFIG_BT_CTLR_DATA_LENGTH_MAX=251
CONFIG_BT_BUF_ACL_RX_SIZE=251
CONFIG_BT_BUF_ACL_TX_SIZE=251
CONFIG_BT_L2CAP_TX_MTU=247
CONFIG_BT_BUF_ACL_TX_COUNT=10
CONFIG_BT_BUF_EVT_RX_COUNT=16
CONFIG_BT_L2CAP_TX_BUF_COUNT=10
CONFIG_BT_CONN_TX_MAX=10
CONFIG_BT_GAP_AUTO_UPDATE_CONN_PARAMS=n
# High-rate IMU + audio is ~33 kB/s: let the controller queue more packets
# per connection event (default 3).
CONFIG_BT_CTLR_SDC_TX_PACKET_COUNT=8

# Maximum TX power (+4 dBm, default 0): the chip antenna loses 10-20 dB when
# the board is worn against the skin. Costs ~0.3-0.8 mA while streaming.
CONFIG_BT_CTLR_TX_PWR_PLUS_4=y
```

## release.conf
```kconfig
# Field build: no RTT console or logging.
# VS Code: add this file under "Extra Kconfig fragments" of a build
# configuration; command line: west build ... -- -DEXTRA_CONF_FILE=release.conf
CONFIG_LOG=n
CONFIG_CONSOLE=n
CONFIG_RTT_CONSOLE=n
CONFIG_USE_SEGGER_RTT=n
```

## src/main.c
```c
/*
 * DIBS firmware: a data-collection device. On the phone's request it records
 * the microphone and the IMU together and streams both over BLE with the
 * timing needed to align them (see protocol.h); it also reports
 * battery/charging state.
 */
#include <zephyr/kernel.h>
#include <zephyr/logging/log.h>

#include "audio.h"
#include "battery.h"
#include "ble.h"
#include "imu.h"
#include "protocol.h"
#include "session.h"
#include "timebase.h"
#include "watchdog.h"

LOG_MODULE_REGISTER(main, LOG_LEVEL_INF);

int main(void)
{
	uint32_t reset_reason = NRF_POWER->RESETREAS;
	int err;

	NRF_POWER->RESETREAS = reset_reason; /* write-1-to-clear */
	LOG_INF("DIBS fw %x, reset reason 0x%08x", DIBS_FW_VERSION, reset_reason);

	err = watchdog_init();
	if (!err) {
		err = timebase_init();
	}
	if (!err) {
		err = imu_init();
	}
	if (!err) {
		err = audio_init();
	}
	if (err) {
		LOG_ERR("init failed: %d", err);
		return 0;
	}

	session_init(reset_reason);
	err = ble_init();
	if (err) {
		return 0;
	}

	battery_init();
	LOG_INF("DIBS ready");
	return 0;
}
```

## src/adpcm.c
```c
#include "adpcm.h"

static const int16_t step_table[89] = {
	7, 8, 9, 10, 11, 12, 13, 14, 16, 17, 19, 21, 23, 25, 28, 31, 34, 37,
	41, 45, 50, 55, 60, 66, 73, 80, 88, 97, 107, 118, 130, 143, 157, 173,
	190, 209, 230, 253, 279, 307, 337, 371, 408, 449, 494, 544, 598, 658,
	724, 796, 876, 963, 1060, 1166, 1282, 1411, 1552, 1707, 1878, 2066,
	2272, 2499, 2749, 3024, 3327, 3660, 4026, 4428, 4871, 5358, 5894,
	6484, 7132, 7845, 8630, 9493, 10442, 11487, 12635, 13899, 15289,
	16818, 18500, 20350, 22385, 24623, 27086, 29794, 32767,
};

static const int8_t index_table[16] = {
	-1, -1, -1, -1, 2, 4, 6, 8, -1, -1, -1, -1, 2, 4, 6, 8,
};

static uint8_t encode_sample(struct adpcm_state *st, int16_t sample)
{
	int step = step_table[st->index];
	int diff = sample - st->predictor;
	int vpdiff = step >> 3;
	uint8_t nibble = 0;

	if (diff < 0) {
		nibble = 8;
		diff = -diff;
	}
	if (diff >= step) {
		nibble |= 4;
		diff -= step;
		vpdiff += step;
	}
	step >>= 1;
	if (diff >= step) {
		nibble |= 2;
		diff -= step;
		vpdiff += step;
	}
	step >>= 1;
	if (diff >= step) {
		nibble |= 1;
		vpdiff += step;
	}

	int pred = st->predictor + ((nibble & 8) ? -vpdiff : vpdiff);

	st->predictor = pred > INT16_MAX ? INT16_MAX : pred < INT16_MIN ? INT16_MIN : pred;

	int index = st->index + index_table[nibble];

	st->index = index < 0 ? 0 : index > 88 ? 88 : index;
	return nibble;
}

void adpcm_encode(struct adpcm_state *st, const int16_t *in, size_t n, uint8_t *out)
{
	for (size_t i = 0; i < n; i += 2) {
		uint8_t lo = encode_sample(st, in[i]);
		uint8_t hi = encode_sample(st, in[i + 1]);

		*out++ = lo | (hi << 4);
	}
}
```

## src/adpcm.h
```c
#ifndef DIBS_ADPCM_H_
#define DIBS_ADPCM_H_

#include <stddef.h>
#include <stdint.h>

struct adpcm_state {
	int16_t predictor;
	uint8_t index;
};

/* IMA ADPCM: encodes n samples (n even) into n / 2 bytes, low nibble first. */
void adpcm_encode(struct adpcm_state *st, const int16_t *in, size_t n, uint8_t *out);

#endif /* DIBS_ADPCM_H_ */
```

## src/audio.c
```c
/*
 * Microphone capture: 20 ms PDM blocks -> DC-blocking filter -> IMA ADPCM ->
 * BLE notifications, called from the session thread so a slow link only
 * stalls the mic queue, never the BLE stack.
 */
#include "audio.h"

#include <string.h>
#include <zephyr/audio/dmic.h>
#include <zephyr/kernel.h>
#include <zephyr/logging/log.h>
#include <zephyr/sys/byteorder.h>
#include <hal/nrf_gpio.h>
#include <hal/nrf_pdm.h>

#include "adpcm.h"
#include "ble.h"
#include "protocol.h"
#include "timebase.h"

LOG_MODULE_REGISTER(audio, LOG_LEVEL_INF);

#define REQ_RATE    16000
#define BLOCK_SAMP  320                            /* 20 ms */
#define BLOCK_BYTES (BLOCK_SAMP * sizeof(int16_t))
#define SETTLE_BLOCKS 5                            /* drop 100 ms of PDM start-up */
/* PDM_CLK (P0.16, see the board DTS); held low between sessions so the
 * microphone sleeps. */
#define MIC_CLK_PIN 16

K_MEM_SLAB_DEFINE_STATIC(mic_slab, BLOCK_BYTES, 8, 4);

static const struct device *const mic = DEVICE_DT_GET(DT_ALIAS(dmic0));

static struct adpcm_state adpcm;
static struct dc_block_state {
	bool primed;
	int32_t x1;
	int32_t y1_q8;
} dc;
static uint32_t blocks;
static struct audio_stats stats;

/* rate 0 releases the PDM peripheral (driver uninit). */
static int mic_configure(uint32_t rate)
{
	struct pcm_stream_cfg stream = {
		.pcm_rate = rate,
		.pcm_width = 16,
		.block_size = BLOCK_BYTES,
		.mem_slab = &mic_slab,
	};
	struct dmic_cfg cfg = {
		.io = {
			.min_pdm_clk_freq = 1000000,
			.max_pdm_clk_freq = 3250000,
			.min_pdm_clk_dc = 40,
			.max_pdm_clk_dc = 60,
		},
		.streams = &stream,
		.channel = {
			.req_num_streams = 1,
			.req_num_chan = 1,
			/* ICS-41350 SELECT = GND: left channel. */
			.req_chan_map_lo = dmic_build_channel_map(0, 0, PDM_CHAN_LEFT),
		},
	};

	return dmic_configure(mic, &cfg);
}

/* First-order DC blocker, y[n] = x[n] - x[n-1] + 0.996 y[n-1] (fc ~10 Hz).
 * y is kept in Q8 so the rounding of the feedback term doesn't add up to a
 * DC offset of its own. */
static void dc_block(struct dc_block_state *f, int16_t *s, size_t n)
{
	if (!f->primed) {
		f->x1 = s[0];
		f->primed = true;
	}
	for (size_t i = 0; i < n; i++) {
		f->y1_q8 = ((s[i] - f->x1) << 8) +
			   (int32_t)(((int64_t)f->y1_q8 * 4080 + 2048) >> 12);
		f->x1 = s[i];
		s[i] = CLAMP((f->y1_q8 + 128) >> 8, INT16_MIN, INT16_MAX);
	}
}

static void drain_mic(void)
{
	void *buf;
	size_t size;

	while (dmic_read(mic, 0, &buf, &size, 0) == 0) {
		k_mem_slab_free(&mic_slab, buf);
	}
}

/* 32 MHz * PDMCLKCTRL / 2^32 is the PDM clock; the decimation ratio is 64. */
uint32_t audio_pdm_clk_hz(void)
{
	return (uint32_t)((32000000ULL * NRF_PDM->PDMCLKCTRL) >> 32);
}

uint16_t audio_skip_samples(void)
{
	return SETTLE_BLOCKS * BLOCK_SAMP;
}

int audio_init(void)
{
	return device_is_ready(mic) ? 0 : -ENODEV;
}

/* The PDM peripheral is configured only for a session, so between sessions
 * it is disabled and the microphone's clock stays off. */
int audio_begin(void)
{
	int err = mic_configure(REQ_RATE);

	if (err) {
		return err;
	}
	memset(&adpcm, 0, sizeof(adpcm));
	memset(&dc, 0, sizeof(dc));
	memset(&stats, 0, sizeof(stats));
	blocks = 0;
	return dmic_trigger(mic, DMIC_TRIGGER_START);
}

int audio_process_block(void)
{
	static uint8_t scratch[BLE_TX_MAX_LEN];
	void *buf;
	size_t size;
	int err = dmic_read(mic, 0, &buf, &size, 200);

	if (err) {
		return err;
	}
	/* The driver hands over a buffer on its PDM END event, so the latest
	 * captured END is this buffer's, unless we fell a whole block behind
	 * (the phone's fit rejects that as an outlier). */
	uint32_t end_us = timebase_pdm_end_us();

	int16_t *s = buf;
	size_t n = size / sizeof(int16_t);

	dc_block(&dc, s, n);
	if (blocks++ < SETTLE_BLOCKS || ble_audio_max_len() <= DIBS_AUDIO_HDR_LEN) {
		k_mem_slab_free(&mic_slab, buf);
		return 0;
	}

	/* Split the block into packets that fit the current MTU. */
	size_t max_samp = MIN((ble_audio_max_len() - DIBS_AUDIO_HDR_LEN) * 2,
			      (BLE_TX_MAX_LEN - DIBS_AUDIO_HDR_LEN) * 2) & ~1U;

	for (size_t off = 0; off < n; off += max_samp) {
		size_t cnt = MIN(max_samp, n - off);
		uint8_t *pkt = ble_tx_alloc(BLE_CHAN_AUDIO);
		/* A dropped packet is still encoded: the ADPCM state must move on
		 * and its seq number tells the phone it is missing. */
		uint8_t *p = pkt ? pkt : scratch;

		sys_put_le16(stats.packets++, &p[0]);
		sys_put_le16((uint16_t)adpcm.predictor, &p[2]);
		p[4] = adpcm.index;
		sys_put_le32(off + cnt == n ? end_us : 0, &p[5]);
		adpcm_encode(&adpcm, &s[off], cnt, &p[DIBS_AUDIO_HDR_LEN]);

		if (pkt) {
			ble_tx_submit(BLE_CHAN_AUDIO, pkt, DIBS_AUDIO_HDR_LEN + cnt / 2);
		}
	}
	k_mem_slab_free(&mic_slab, buf);
	return 0;
}

void audio_end(struct audio_stats *out)
{
	dmic_trigger(mic, DMIC_TRIGGER_STOP);
	k_msleep(30);
	drain_mic();
	mic_configure(0);
	nrf_gpio_pin_clear(MIC_CLK_PIN);
	nrf_gpio_cfg_output(MIC_CLK_PIN);
	stats.dropped = ble_tx_dropped(BLE_CHAN_AUDIO);
	LOG_INF("audio stopped: %u packets, %u dropped so far", stats.packets, stats.dropped);
	if (out) {
		*out = stats;
	}
}
```

## src/audio.h
```c
#ifndef DIBS_AUDIO_H_
#define DIBS_AUDIO_H_

#include <stdint.h>

struct audio_stats {
	uint16_t packets;
	uint16_t dropped; /* notifications the board could not send */
};

/* Microphone capture driven by the session thread. */
int audio_init(void);
int audio_begin(void);
/* Waits for the next 20 ms block, encodes and sends it. */
int audio_process_block(void);
void audio_end(struct audio_stats *stats);

uint32_t audio_pdm_clk_hz(void);
uint16_t audio_skip_samples(void);

#endif /* DIBS_AUDIO_H_ */
```

## src/battery.c
```c
#include "battery.h"

#include <stdlib.h>
#include <string.h>
#include <zephyr/drivers/charger.h>
#include <zephyr/drivers/fuel_gauge.h>
#include <zephyr/drivers/i2c.h>
#include <zephyr/kernel.h>
#include <zephyr/logging/log.h>

#include "ble.h"
#include "protocol.h"
#include "session.h"

LOG_MODULE_REGISTER(battery, LOG_LEVEL_INF);

/* Connected and awake: report every 5 s. Otherwise keep guarding the cell
 * once a minute (the hibernating gauge measures every 45 s anyway). */
#define POLL_ACTIVE K_SECONDS(5)
#define POLL_GUARD  K_SECONDS(60)

/* Low-battery protection, on battery only (USB absent), each acting after
 * DEBOUNCE consecutive readings so a load dip does not trigger it:
 *  - below LOW_MV: stop the session and refuse new ones,
 *  - back above LOW_CLEAR_MV (or USB in): allow sessions again,
 *  - below CRITICAL_MV: shut the board down before the charger's 3.0 V
 *    BUVLO cut-off, so the cell is not drained further while idle. */
#define LOW_MV       3300
#define LOW_CLEAR_MV 3450
#define CRITICAL_MV  3150
#define DEBOUNCE     3

/* BQ25180: there is no push button on TS/MR (fixed 10 k to GND). With
 * EN_PUSH set, battery-only mode pulses the TS current source to look for
 * one (IQ_BAT 4-5 uA instead of 3-3.5 uA). EN_RST_SHIP = 01 enters
 * shutdown mode (15 nA, wake on adapter insert only); with an adapter
 * present the request waits until it is removed. */
#define BQ25180_REG_SHIP_RST 0x09
#define BQ25180_EN_PUSH      BIT(0)
#define BQ25180_EN_RST_SHIP  (BIT(6) | BIT(5))
#define BQ25180_SHUTDOWN     BIT(5)
#define SHIP_DELAY           K_MSEC(300) /* let the BLE reply go out first */

/* MAX17048 HIBRT: 0xFFFF forces hibernate (ADC every 45 s, ~3 uA),
 * 0x0000 keeps it active (every 250 ms, ~23 uA). */
#define MAX17048_REG_HIBRT  0x0A
#define HIBRT_ALWAYS_HIBERNATE 0xFFFF
#define HIBRT_NEVER_HIBERNATE  0x0000

static const struct device *const gauge = DEVICE_DT_GET(DT_ALIAS(fuel_gauge0));
static const struct device *const chg = DEVICE_DT_GET(DT_ALIAS(charger0));
static const struct i2c_dt_spec gauge_bus = I2C_DT_SPEC_GET(DT_ALIAS(fuel_gauge0));
static const struct i2c_dt_spec charger_bus = I2C_DT_SPEC_GET(DT_ALIAS(charger0));
static bool active;
static atomic_t low;
static bool ship_pending;
static uint8_t below_low, below_critical;

static struct dibs_battery last;
static void poll(struct k_work *work);
static K_WORK_DELAYABLE_DEFINE(poll_work, poll);
static void shutdown(struct k_work *work);
static K_WORK_DELAYABLE_DEFINE(shutdown_work, shutdown);
static void ship_request(struct k_work *work);
static K_WORK_DEFINE(ship_work, ship_request);

static uint8_t charge_state(void)
{
	union charger_propval online, status;

	if (charger_get_prop(chg, CHARGER_PROP_ONLINE, &online) ||
	    charger_get_prop(chg, CHARGER_PROP_STATUS, &status)) {
		return DIBS_CHARGE_UNKNOWN;
	}
	if (online.online == CHARGER_ONLINE_OFFLINE) {
		return DIBS_CHARGE_DISCHARGING;
	}

	switch (status.status) {
	case CHARGER_STATUS_CHARGING:
		return DIBS_CHARGE_CHARGING;
	case CHARGER_STATUS_FULL:
		return DIBS_CHARGE_FULL;
	case CHARGER_STATUS_NOT_CHARGING:
		return DIBS_CHARGE_NOT_CHARGING;
	default:
		return DIBS_CHARGE_UNKNOWN;
	}
}

static void shutdown(struct k_work *work)
{
	LOG_WRN("entering charger shutdown mode%s", ship_pending ? " when USB is removed" : "");
	if (i2c_reg_update_byte_dt(&charger_bus, BQ25180_REG_SHIP_RST, BQ25180_EN_RST_SHIP,
				   BQ25180_SHUTDOWN)) {
		LOG_ERR("shutdown request failed");
	}
}

static void protect(uint16_t mv, bool usb)
{
	if (usb || mv == 0) {
		below_low = 0;
		below_critical = 0;
		if (usb) {
			atomic_set(&low, 0);
		}
		return;
	}

	below_low = mv < LOW_MV ? MIN(below_low + 1, DEBOUNCE) : 0;
	below_critical = mv < CRITICAL_MV ? MIN(below_critical + 1, DEBOUNCE) : 0;

	if (below_low == DEBOUNCE && !atomic_get(&low)) {
		LOG_WRN("battery low (%u mV): stopping and refusing sessions", mv);
		atomic_set(&low, 1);
		session_stop(DIBS_END_LOW_BATTERY);
	} else if (mv >= LOW_CLEAR_MV) {
		atomic_set(&low, 0);
	}

	if (below_critical == DEBOUNCE) {
		LOG_WRN("battery critical (%u mV)", mv);
		session_stop(DIBS_END_LOW_BATTERY);
		k_work_reschedule(&shutdown_work, SHIP_DELAY);
	}
}

static void poll(struct k_work *work)
{
	struct dibs_battery b = { .version = 1 };
	union fuel_gauge_prop_val v, soc;

	if (fuel_gauge_get_prop(gauge, FUEL_GAUGE_VOLTAGE, &v) == 0) {
		b.voltage_mv = v.voltage / 1000;
	}
	if (fuel_gauge_get_prop(gauge, FUEL_GAUGE_RELATIVE_STATE_OF_CHARGE, &soc) == 0) {
		b.soc = soc.relative_state_of_charge;
	}
	b.charge = charge_state();
	bool usb = b.charge >= DIBS_CHARGE_NOT_CHARGING;

	protect(b.voltage_mv, usb);
	b.flags = (usb ? DIBS_BATTERY_USB_PRESENT : 0) |
		  (atomic_get(&low) ? DIBS_BATTERY_LOW : 0) |
		  (ship_pending ? DIBS_BATTERY_SHIP_PENDING : 0);

	/* Only notify on a state change or a voltage step worth showing. */
	if (b.charge != last.charge || b.flags != last.flags || b.soc != last.soc ||
	    abs((int)b.voltage_mv - (int)last.voltage_mv) >= 10) {
		LOG_INF("battery %u mV, %u %%, charge %u, usb %u", b.voltage_mv, b.soc,
			b.charge, (b.flags & DIBS_BATTERY_USB_PRESENT) ? 1 : 0);
		last = b;
		ble_set_battery(&b);
	}

	k_work_reschedule(&poll_work, active ? POLL_ACTIVE : POLL_GUARD);
}

static void set_hibernate(bool hibernate)
{
	uint16_t v = hibernate ? HIBRT_ALWAYS_HIBERNATE : HIBRT_NEVER_HIBERNATE;
	uint8_t buf[3] = { MAX17048_REG_HIBRT, v >> 8, v & 0xFF };

	if (i2c_write_dt(&gauge_bus, buf, sizeof(buf))) {
		LOG_WRN("fuel gauge hibernate %u failed", hibernate);
	}
}

void battery_init(void)
{
	if (!device_is_ready(gauge) || !device_is_ready(chg)) {
		LOG_ERR("fuel gauge or charger not ready");
		return;
	}
	if (i2c_reg_update_byte_dt(&charger_bus, BQ25180_REG_SHIP_RST, BQ25180_EN_PUSH, 0)) {
		LOG_WRN("could not disable the charger push button");
	}
	set_hibernate(true);
	k_work_reschedule(&poll_work, K_NO_WAIT);
}

bool battery_is_low(void)
{
	return atomic_get(&low);
}

/* Runs on the system workqueue, like the polling, so the I2C traffic stays
 * off the BLE thread that received the command. */
static void ship_request(struct k_work *work)
{
	union charger_propval online;

	session_stop(DIBS_END_STOP);
	ship_pending = charger_get_prop(chg, CHARGER_PROP_ONLINE, &online) == 0 &&
		       online.online != CHARGER_ONLINE_OFFLINE;
	/* Publish the pending flag before the board (maybe) loses power. */
	memset(&last, 0, sizeof(last));
	k_work_reschedule(&poll_work, K_NO_WAIT);
	k_work_reschedule(&shutdown_work, SHIP_DELAY);
}

void battery_request_shutdown(void)
{
	k_work_submit(&ship_work);
}

void battery_set_active(bool on)
{
	if (on == active) {
		return;
	}
	active = on;
	set_hibernate(!on);
	if (on) {
		/* Report right away so the phone sees fresh values. */
		memset(&last, 0, sizeof(last));
		k_work_reschedule(&poll_work, K_NO_WAIT);
	}
	LOG_INF("fuel gauge %s", on ? "active" : "hibernating");
}
```

## src/battery.h
```c
#ifndef DIBS_BATTERY_H_
#define DIBS_BATTERY_H_

#include <stdbool.h>

/* While active, polls the fuel gauge and charger every 5 s and publishes
 * changes over BLE; otherwise the fuel gauge hibernates and the battery is
 * checked once a minute. Starts inactive. Guards the cell on battery: low
 * stops sessions, critical shuts the board down (see battery.c). */
void battery_init(void);
void battery_set_active(bool on);

/* On battery and below the low threshold: no new sessions. */
bool battery_is_low(void);

/* Charger shutdown mode for storage; deferred until USB is removed. */
void battery_request_shutdown(void);

#endif /* DIBS_BATTERY_H_ */
```

## src/ble.c
```c
#include "ble.h"

#include <string.h>

#include <zephyr/bluetooth/bluetooth.h>
#include <zephyr/bluetooth/conn.h>
#include <zephyr/bluetooth/gatt.h>
#include <zephyr/bluetooth/uuid.h>
#include <zephyr/logging/log.h>
#include <zephyr/sys/byteorder.h>

#include "battery.h"
#include "power.h"
#include "protocol.h"
#include "session.h"

LOG_MODULE_REGISTER(ble, LOG_LEVEL_INF);

static const struct bt_uuid_128 svc_uuid = BT_UUID_INIT_128(DIBS_UUID_SERVICE);
static const struct bt_uuid_128 control_uuid = BT_UUID_INIT_128(DIBS_UUID_CONTROL);
static const struct bt_uuid_128 audio_uuid = BT_UUID_INIT_128(DIBS_UUID_AUDIO);
static const struct bt_uuid_128 status_uuid = BT_UUID_INIT_128(DIBS_UUID_STATUS);
static const struct bt_uuid_128 battery_uuid = BT_UUID_INIT_128(DIBS_UUID_BATTERY);
static const struct bt_uuid_128 imu_uuid = BT_UUID_INIT_128(DIBS_UUID_IMU);

static struct bt_conn *current_conn;
static bool audio_subscribed;
static bool status_subscribed;
static bool battery_subscribed;
static bool imu_subscribed;
static struct dibs_status status = { .version = DIBS_PROTOCOL_VERSION };
static struct dibs_battery battery = { .version = 1 };

static ssize_t control_write(struct bt_conn *conn, const struct bt_gatt_attr *attr,
			     const void *buf, uint16_t len, uint16_t offset, uint8_t flags)
{
	const uint8_t *cmd = buf;

	if (offset != 0 || len < 1 || len > 3) {
		return BT_GATT_ERR(BT_ATT_ERR_INVALID_ATTRIBUTE_LEN);
	}

	switch (cmd[0]) {
	case DIBS_CMD_START:
		if ((len >= 2 && cmd[1] > DIBS_IMU_MODE_HIGHRATE_IMU_ONLY) ||
		    (len == 3 && cmd[2] != DIBS_PHY_1M && cmd[2] != DIBS_PHY_2M)) {
			return BT_GATT_ERR(BT_ATT_ERR_VALUE_NOT_ALLOWED);
		}
		session_start(len >= 2 ? cmd[1] : DIBS_IMU_MODE_STANDARD,
			      len == 3 ? cmd[2] : DIBS_PHY_2M);
		break;
	case DIBS_CMD_STOP:
		session_stop(DIBS_END_STOP);
		break;
	case DIBS_CMD_SHIP:
		battery_request_shutdown();
		break;
	default:
		return BT_GATT_ERR(BT_ATT_ERR_VALUE_NOT_ALLOWED);
	}
	return len;
}

static ssize_t status_read(struct bt_conn *conn, const struct bt_gatt_attr *attr,
			   void *buf, uint16_t len, uint16_t offset)
{
	return bt_gatt_attr_read(conn, attr, buf, len, offset, &status, sizeof(status));
}

static ssize_t battery_read(struct bt_conn *conn, const struct bt_gatt_attr *attr,
			    void *buf, uint16_t len, uint16_t offset)
{
	return bt_gatt_attr_read(conn, attr, buf, len, offset, &battery, sizeof(battery));
}

static void audio_ccc_changed(const struct bt_gatt_attr *attr, uint16_t value)
{
	audio_subscribed = value == BT_GATT_CCC_NOTIFY;
}

static void status_ccc_changed(const struct bt_gatt_attr *attr, uint16_t value)
{
	status_subscribed = value == BT_GATT_CCC_NOTIFY;
}

static void battery_ccc_changed(const struct bt_gatt_attr *attr, uint16_t value)
{
	battery_subscribed = value == BT_GATT_CCC_NOTIFY;
}

static void imu_ccc_changed(const struct bt_gatt_attr *attr, uint16_t value)
{
	imu_subscribed = value == BT_GATT_CCC_NOTIFY;
}

BT_GATT_SERVICE_DEFINE(dibs_svc,
	BT_GATT_PRIMARY_SERVICE(&svc_uuid),
	BT_GATT_CHARACTERISTIC(&control_uuid.uuid,
			       BT_GATT_CHRC_WRITE | BT_GATT_CHRC_WRITE_WITHOUT_RESP,
			       BT_GATT_PERM_WRITE, NULL, control_write, NULL),
	BT_GATT_CHARACTERISTIC(&audio_uuid.uuid, BT_GATT_CHRC_NOTIFY,
			       BT_GATT_PERM_NONE, NULL, NULL, NULL),
	BT_GATT_CCC(audio_ccc_changed, BT_GATT_PERM_READ | BT_GATT_PERM_WRITE),
	BT_GATT_CHARACTERISTIC(&status_uuid.uuid,
			       BT_GATT_CHRC_READ | BT_GATT_CHRC_NOTIFY,
			       BT_GATT_PERM_READ, status_read, NULL, NULL),
	BT_GATT_CCC(status_ccc_changed, BT_GATT_PERM_READ | BT_GATT_PERM_WRITE),
	BT_GATT_CHARACTERISTIC(&battery_uuid.uuid,
			       BT_GATT_CHRC_READ | BT_GATT_CHRC_NOTIFY,
			       BT_GATT_PERM_READ, battery_read, NULL, NULL),
	BT_GATT_CCC(battery_ccc_changed, BT_GATT_PERM_READ | BT_GATT_PERM_WRITE),
	BT_GATT_CHARACTERISTIC(&imu_uuid.uuid, BT_GATT_CHRC_NOTIFY,
			       BT_GATT_PERM_NONE, NULL, NULL, NULL),
	BT_GATT_CCC(imu_ccc_changed, BT_GATT_PERM_READ | BT_GATT_PERM_WRITE),
);

/* Attribute indices in dibs_svc used for notifications. */
#define ATTR_AUDIO   4
#define ATTR_STATUS  7
#define ATTR_BATTERY 10
#define ATTR_IMU     13

static const struct bt_data ad[] = {
	BT_DATA_BYTES(BT_DATA_FLAGS, (BT_LE_AD_GENERAL | BT_LE_AD_NO_BREDR)),
	BT_DATA_BYTES(BT_DATA_UUID128_ALL, DIBS_UUID_SERVICE),
};

/* "DIBS_Audio-XXXX", XXXX = low 16 bits of the FICR device ID, so several
 * boards can be told apart in the phone's device list (15 characters: fits
 * the scan response). */
static char device_name[sizeof("DIBS_Audio-XXXX")];

static struct bt_data sd[] = {
	BT_DATA(BT_DATA_NAME_COMPLETE, device_name, 0),
};

/* 1.00-1.08 s: slow enough to cost little, and iOS still finds the board
 * within a few seconds. */
static const struct bt_le_adv_param *adv_param =
	BT_LE_ADV_PARAM(BT_LE_ADV_OPT_CONN, 0x0640, 0x06C0, NULL);

/* Units: interval 1.25 ms, timeout 10 ms. Idle: 30-45 ms with latency 20,
 * so with nothing to send the board wakes about once a second. Recording:
 * 15-30 ms without latency for the audio + IMU stream; high-rate IMU asks
 * for 15 ms (a Mac sends only ~2 packets per connection event, so the
 * centrals' usual 30 ms choice carries half the ~150 packets/s). All fit
 * Apple's rules (multiples of 15 ms, latency <= 30, timeout 6 s). */
static const struct bt_le_conn_param links[] = {
	[BLE_LINK_IDLE] = BT_LE_CONN_PARAM_INIT(24, 36, 20, 600),
	[BLE_LINK_FAST] = BT_LE_CONN_PARAM_INIT(12, 24, 0, 600),
	[BLE_LINK_FASTEST] = BT_LE_CONN_PARAM_INIT(12, 12, 0, 600),
};

static atomic_t adv_allowed = ATOMIC_INIT(1);
static atomic_t link_wanted = ATOMIC_INIT(BLE_LINK_IDLE);
/* Current connection interval, 1.25 ms units (0: not connected). */
static atomic_t link_interval;
/* PHY in use (TX) and the one asked for (BT_GAP_LE_PHY_1M/2M = DIBS_PHY_*). */
static atomic_t link_phy;
static atomic_t phy_wanted = ATOMIC_INIT(DIBS_PHY_2M);

static void advertise(void)
{
	if (!atomic_get(&adv_allowed) || current_conn) {
		return;
	}

	int err = bt_le_adv_start(adv_param, ad, ARRAY_SIZE(ad), sd, ARRAY_SIZE(sd));

	if (err == -EALREADY) {
		return;
	}
	if (err) {
		/* Usually -ENOMEM until the last connection is recycled, which
		 * calls advertise() again. */
		LOG_WRN("advertising failed: %d", err);
	} else {
		LOG_INF("advertising as \"%s\"", device_name);
	}
}

static void connected(struct bt_conn *conn, uint8_t err)
{
	if (err) {
		LOG_WRN("connection failed: 0x%02x", err);
		return;
	}
	LOG_INF("connected");
	current_conn = bt_conn_ref(conn);
	power_set_connected(true);

	struct bt_conn_info info;

	if (bt_conn_get_info(conn, &info) == 0) {
		atomic_set(&link_interval, info.le.interval);
		atomic_set(&link_phy, info.le.phy ? info.le.phy->tx_phy : 0);
	}

	bt_conn_le_param_update(conn, &links[atomic_get(&link_wanted)]);
	/* 2M PHY and 251-byte data length are negotiated by the host
	 * automatically (BT_AUTO_PHY_UPDATE, BT_AUTO_DATA_LEN_UPDATE). Don't
	 * request them here: this callback runs on the thread that has to
	 * process their HCI responses. */
}

static void disconnected(struct bt_conn *conn, uint8_t reason)
{
	LOG_INF("disconnected: 0x%02x", reason);
	session_stop(DIBS_END_DISCONNECT);
	audio_subscribed = false;
	imu_subscribed = false;
	status_subscribed = false;
	battery_subscribed = false;
	if (current_conn) {
		bt_conn_unref(current_conn);
		current_conn = NULL;
	}
	atomic_set(&link_interval, 0);
	atomic_set(&link_phy, 0);
	power_set_connected(false);
}

static void recycled(void)
{
	advertise();
}

static void le_param_updated(struct bt_conn *conn, uint16_t interval,
			     uint16_t latency, uint16_t timeout)
{
	atomic_set(&link_interval, interval);
	LOG_INF("conn interval %u.%02u ms", interval * 125 / 100, interval * 125 % 100);
}

static void le_phy_updated(struct bt_conn *conn, struct bt_conn_le_phy_info *info)
{
	atomic_set(&link_phy, info->tx_phy);
	LOG_INF("PHY tx %u rx %u", info->tx_phy, info->rx_phy);
}

BT_CONN_CB_DEFINE(conn_callbacks) = {
	.connected = connected,
	.disconnected = disconnected,
	.recycled = recycled,
	.le_param_updated = le_param_updated,
	.le_phy_updated = le_phy_updated,
};

static void mtu_updated(struct bt_conn *conn, uint16_t tx, uint16_t rx)
{
	LOG_INF("ATT MTU %u", bt_gatt_get_mtu(conn));
}

static struct bt_gatt_cb gatt_callbacks = {
	.att_mtu_updated = mtu_updated,
};

int ble_init(void)
{
	snprintk(device_name, sizeof(device_name), "DIBS_Audio-%04X",
		 (uint16_t)NRF_FICR->DEVICEID[0]);
	sd[0].data_len = strlen(device_name);

	int err = bt_enable(NULL);

	if (err) {
		LOG_ERR("bt_enable: %d", err);
		return err;
	}
	err = bt_set_name(device_name);
	if (err) {
		LOG_WRN("bt_set_name: %d", err);
	}
	bt_gatt_cb_register(&gatt_callbacks);
	advertise();
	return 0;
}

void ble_set_advertising(bool allowed)
{
	atomic_set(&adv_allowed, allowed);
	if (allowed) {
		advertise();
	} else if (!current_conn) {
		bt_le_adv_stop();
		LOG_INF("advertising stopped (parked)");
	}
}

bool ble_link_ready(void)
{
	return current_conn &&
	       atomic_get(&link_interval) <= links[atomic_get(&link_wanted)].interval_max &&
	       atomic_get(&link_phy) == atomic_get(&phy_wanted);
}

void ble_set_phy(uint8_t phy)
{
	atomic_set(&phy_wanted, phy);
	if (current_conn && atomic_get(&link_phy) != phy) {
		int err = bt_conn_le_phy_update(current_conn, phy == DIBS_PHY_1M
						? BT_CONN_LE_PHY_PARAM_1M : BT_CONN_LE_PHY_PARAM_2M);

		if (err) {
			LOG_WRN("PHY update: %d", err);
		}
	}
}

uint8_t ble_phy(void)
{
	return atomic_get(&link_phy);
}

void ble_set_link(enum ble_link link)
{
	atomic_set(&link_wanted, link);
	if (current_conn) {
		bt_conn_le_param_update(current_conn, &links[link]);
	}
}

size_t ble_audio_max_len(void)
{
	if (!current_conn || !audio_subscribed) {
		return 0;
	}
	return bt_gatt_get_mtu(current_conn) - 3;
}

static int notify(enum ble_chan chan, const uint8_t *data, size_t len)
{
	bool subscribed = chan == BLE_CHAN_AUDIO ? audio_subscribed : imu_subscribed;

	if (!current_conn || !subscribed) {
		return -ENOTCONN;
	}
	if (len > bt_gatt_get_mtu(current_conn) - 3) {
		return -EMSGSIZE;
	}
	return bt_gatt_notify(current_conn,
			      &dibs_svc.attrs[chan == BLE_CHAN_AUDIO ? ATTR_AUDIO : ATTR_IMU],
			      data, len);
}

/* ~200 ms of audio + high-rate IMU (~150 packets/s). */
#define TX_BLOCK 248
#define TX_COUNT 28

struct tx_item {
	uint8_t *buf;
	uint16_t len;
	uint8_t chan;
};

K_MEM_SLAB_DEFINE_STATIC(tx_slab, TX_BLOCK, TX_COUNT, 4);
K_MSGQ_DEFINE(tx_q, sizeof(struct tx_item), TX_COUNT, 4);
static atomic_t tx_busy;
static atomic_t tx_dropped[BLE_CHAN_COUNT];

uint8_t *ble_tx_alloc(enum ble_chan chan)
{
	void *buf;

	if (k_mem_slab_alloc(&tx_slab, &buf, K_NO_WAIT)) {
		atomic_inc(&tx_dropped[chan]);
		return NULL;
	}
	return buf;
}

void ble_tx_submit(enum ble_chan chan, uint8_t *buf, size_t len)
{
	struct tx_item item = { .buf = buf, .len = len, .chan = chan };

	if (k_msgq_put(&tx_q, &item, K_NO_WAIT)) {
		atomic_inc(&tx_dropped[chan]);
		k_mem_slab_free(&tx_slab, buf);
	}
}

uint16_t ble_tx_dropped(enum ble_chan chan)
{
	return atomic_get(&tx_dropped[chan]);
}

void ble_tx_reset(void)
{
	for (int i = 0; i < BLE_CHAN_COUNT; i++) {
		atomic_set(&tx_dropped[i], 0);
	}
}

void ble_tx_wait_idle(int timeout_ms)
{
	for (int t = 0; t < timeout_ms; t += 10) {
		if (k_msgq_num_used_get(&tx_q) == 0 && !atomic_get(&tx_busy)) {
			return;
		}
		k_msleep(10);
	}
}

static void tx_thread(void *p1, void *p2, void *p3)
{
	struct tx_item item;

	for (;;) {
		k_msgq_get(&tx_q, &item, K_FOREVER);
		atomic_set(&tx_busy, 1);
		if (notify(item.chan, item.buf, item.len)) {
			atomic_inc(&tx_dropped[item.chan]);
		}
		k_mem_slab_free(&tx_slab, item.buf);
		atomic_set(&tx_busy, 0);
	}
}

/* Below the session (5) and IMU (6) threads: producing data comes first. */
K_THREAD_DEFINE(ble_tx_tid, 1536, tx_thread, NULL, NULL, NULL, 7, 0, 0);

void ble_set_status(const struct dibs_status *s)
{
	/* The struct is little-endian on the wire, like this CPU. */
	status = *s;
	status.version = DIBS_PROTOCOL_VERSION;

	if (current_conn && status_subscribed) {
		bt_gatt_notify(current_conn, &dibs_svc.attrs[ATTR_STATUS], &status,
			       sizeof(status));
	}
}

void ble_set_battery(const struct dibs_battery *b)
{
	battery = *b;
	battery.voltage_mv = sys_cpu_to_le16(b->voltage_mv);

	if (current_conn && battery_subscribed) {
		bt_gatt_notify(current_conn, &dibs_svc.attrs[ATTR_BATTERY], &battery,
			       sizeof(battery));
	}
}
```

## src/ble.h
```c
#ifndef DIBS_BLE_H_
#define DIBS_BLE_H_

#include <stddef.h>
#include <stdint.h>

#include <stdbool.h>

int ble_init(void);

/* Advertising runs only while allowed (power policy) and not connected. */
void ble_set_advertising(bool allowed);

/* Low-duty link with slave latency between sessions, fast links for
 * streaming (fastest for high-rate IMU). */
enum ble_link {
	BLE_LINK_IDLE,
	BLE_LINK_FAST,
	BLE_LINK_FASTEST,
};
void ble_set_link(enum ble_link link);
/* The central has applied an interval within the requested link's range. */
bool ble_link_ready(void);
/* Asks the phone for this PHY (DIBS_PHY_*); ble_link_ready() waits for it. */
void ble_set_phy(uint8_t phy);
/* PHY in use (TX), DIBS_PHY_*, 0 if not connected. */
uint8_t ble_phy(void);

/* Largest audio notification the current connection can carry (0 if the
 * phone is not connected or not subscribed to audio). */
size_t ble_audio_max_len(void);

/* Streaming notifications go through one queue to a sender thread, so the
 * microphone and IMU threads never wait for the link. */
enum ble_chan {
	BLE_CHAN_AUDIO,
	BLE_CHAN_IMU,
	BLE_CHAN_COUNT,
};

#define BLE_TX_MAX_LEN 244 /* ATT MTU 247 - 3 */

/* A buffer of BLE_TX_MAX_LEN bytes for one notification, or NULL when the
 * link has fallen too far behind (the packet then counts as dropped). */
uint8_t *ble_tx_alloc(enum ble_chan chan);
/* Queues a buffer from ble_tx_alloc(); it is freed once sent. */
void ble_tx_submit(enum ble_chan chan, uint8_t *buf, size_t len);
/* Packets of a channel not sent since ble_tx_reset() (no buffer, or the
 * notification failed). */
uint16_t ble_tx_dropped(enum ble_chan chan);
void ble_tx_reset(void);
/* Waits up to timeout_ms for the queue to empty. */
void ble_tx_wait_idle(int timeout_ms);

struct dibs_status;

/* Updates the status characteristic and notifies the phone. */
void ble_set_status(const struct dibs_status *s);

struct dibs_battery;

/* Updates the battery characteristic and notifies the phone. */
void ble_set_battery(const struct dibs_battery *b);

#endif /* DIBS_BLE_H_ */
```

## src/imu.h
```c
#ifndef DIBS_IMU_H_
#define DIBS_IMU_H_

#include <stdint.h>

struct imu_stats {
	uint32_t samples;         /* accelerometer samples sent */
	uint16_t dropped_packets; /* notifications the board could not send */
	uint16_t overruns;        /* FIFO overflows (samples lost on the IMU) */
	uint16_t anchors;
	uint16_t anchors_rejected;
	uint16_t i2c_errors;
	uint16_t bad_tags;        /* FIFO rows with an unexpected tag */
};

/* Rates of one IMU mode (DIBS_IMU_MODE_*), nominal. */
struct imu_mode_info {
	uint16_t accel_odr_hz;
	uint16_t gyro_odr_hz;
	uint16_t accel_per_ts; /* accel samples per FIFO timestamp */
};

/* LSM6DSV32X: accelerometer + gyroscope through the FIFO with timestamps. */
int imu_init(void);
/* 0 or -EINVAL for an unknown mode. */
int imu_mode_get(uint8_t mode, struct imu_mode_info *info);
int imu_start(uint8_t mode);
/* Stops the FIFO and waits (bounded) until queued packets went out. */
void imu_stop(struct imu_stats *stats);
int8_t imu_freq_fine(void);

#define IMU_ACCEL_FS_G    8
#define IMU_GYRO_FS_DPS   2000
#define IMU_ACCEL_UG_LSB  244   /* LSM6DSV32X at +-8 g */
#define IMU_GYRO_MDPS_LSB 70    /* +-2000 dps */

#endif /* DIBS_IMU_H_ */
```

## src/power.c
```c
#include "power.h"

#include <zephyr/kernel.h>
#include <zephyr/logging/log.h>

#include "battery.h"
#include "ble.h"

LOG_MODULE_REGISTER(power, LOG_LEVEL_INF);

static atomic_t connected;
static atomic_t stationary;
static atomic_t recording;

static void apply(struct k_work *work)
{
	bool c = atomic_get(&connected);
	bool parked = atomic_get(&stationary) && !atomic_get(&recording);

	ble_set_advertising(!parked);
	battery_set_active(c && !parked);
	LOG_INF("connected %u, stationary %u, recording %u -> %s", c,
		(unsigned int)atomic_get(&stationary), (unsigned int)atomic_get(&recording),
		parked ? "parked" : "active");
}

static K_WORK_DEFINE(apply_work, apply);

static void set(atomic_t *flag, bool v)
{
	if (atomic_set(flag, v) != v) {
		k_work_submit(&apply_work);
	}
}

void power_set_connected(bool v)
{
	set(&connected, v);
}

void power_set_stationary(bool v)
{
	set(&stationary, v);
}

void power_set_recording(bool v)
{
	set(&recording, v);
}
```

## src/power.h
```c
#ifndef DIBS_POWER_H_
#define DIBS_POWER_H_

#include <stdbool.h>

/*
 * Power policy, from three inputs:
 *  - advertise only while the board moves (or records); after ~68 s still
 *    with no phone connected it goes quiet until the IMU sees motion,
 *  - a connected phone keeps its link; idle links use slave latency,
 *  - the fuel gauge is polled only while a phone is connected and the board
 *    is not parked, and hibernates otherwise.
 */
void power_set_connected(bool connected);
void power_set_stationary(bool stationary);
void power_set_recording(bool recording);

#endif /* DIBS_POWER_H_ */
```
